#include <ili9341_spi.h>
#include <stdio.h>





static inline void lcd_cs_lo() {
    HAL_GPIO_WritePin(GPIOA, LCD_CS_Pin, GPIO_PIN_RESET);

}

static inline void lcd_cs_hi() {
    HAL_GPIO_WritePin(GPIOA, LCD_CS_Pin, GPIO_PIN_SET);

}

static inline void lcd_dc_lo() {
    HAL_GPIO_WritePin(GPIOA, LCD_DC_Pin, GPIO_PIN_RESET);
}
static inline void lcd_dc_hi() {
    HAL_GPIO_WritePin(GPIOA, LCD_DC_Pin, GPIO_PIN_SET);
}

static inline void lcd_reset_lo() {
    HAL_GPIO_WritePin(GPIOA, LCD_RES_Pin, GPIO_PIN_RESET);
}
static inline void lcd_reset_hi() {
	HAL_GPIO_WritePin(GPIOA, LCD_RES_Pin, GPIO_PIN_SET);
}

void LCD_WriteComm(unsigned char comm){
	lcd_dc_lo();
	lcd_cs_lo();
	HAL_SPI_Transmit(&hspi1, &comm, 1, 100);
	lcd_cs_hi();
}

void LCD_WriteData(unsigned char data)
{
	lcd_dc_hi();
	lcd_cs_lo();
	HAL_SPI_Transmit(&hspi1, &data, 1, 100);
	lcd_cs_hi();
}

void LCD_WriteData2(unsigned short data)
{
// Write Data 2 bytes
    unsigned short d;
	lcd_dc_hi();
	lcd_cs_lo();
    d=(data>>8) | (data<<8);
	HAL_SPI_Transmit(&hspi1, (unsigned char *)&d, 2, 100);
	lcd_cs_hi();
}

void LCD_WriteDataN(unsigned char *b,int n)
{
// Write Data N bytes
	lcd_dc_hi();
	lcd_cs_lo();
	HAL_SPI_Transmit(&hspi1, b, n, 100);
	lcd_cs_hi();
}

void LCD_Read(unsigned char com,unsigned char *b,int n){
	lcd_cs_lo();
// Write Command
	lcd_dc_lo();
	HAL_SPI_Transmit(&hspi1, &com, 1, 100);
// Read Data
	lcd_dc_hi();
	HAL_SPI_Receive(&hspi1, 0, b, 100);
	HAL_SPI_Receive(&hspi1, 0, b, 100);
	lcd_cs_hi();
}

void LCD_Init()
{
	lcd_cs_hi();
	lcd_dc_hi();

	// Reset controller
	lcd_reset_hi();
	HAL_Delay(1);
	lcd_reset_lo();
	HAL_Delay(10);
	lcd_reset_hi();
	HAL_Delay(120);

//************* Start Initial Sequence **********//
	LCD_WriteComm(0xCB);
	LCD_WriteData(0x39);
	LCD_WriteData(0x2C);
	LCD_WriteData(0x00);
	LCD_WriteData(0x34);
	LCD_WriteData(0x02);
	LCD_WriteComm(0xCF);
	LCD_WriteData(0x00);
	LCD_WriteData(0XC1);
	LCD_WriteData(0X30);
	LCD_WriteComm(0xE8);
	LCD_WriteData(0x85);
	LCD_WriteData(0x00);
	LCD_WriteData(0x78);
	LCD_WriteComm(0xEA);
	LCD_WriteData(0x00);
	LCD_WriteData(0x00);
	LCD_WriteComm(0xED);
	LCD_WriteData(0x64);
	LCD_WriteData(0x03);
	LCD_WriteData(0X12);
	LCD_WriteData(0X81);
	LCD_WriteComm(0xF7);
	LCD_WriteData(0x20);
	LCD_WriteComm(0xC0);
	LCD_WriteData(0x23);
	LCD_WriteComm(0xC1);
	LCD_WriteData(0x10);
	LCD_WriteComm(0xC5);
	LCD_WriteData(0x3e);
	LCD_WriteData(0x28);
	LCD_WriteComm(0xC7);
	LCD_WriteData(0x86);
	LCD_WriteComm(0x36);
#if LCD_ALIGNMENT == VERTICAL
	LCD_WriteData(0x48);
#elif LCD_ALIGNMENT == HORIZONTAL
	LCD_WriteData(0x0C);
#endif
	LCD_WriteComm(0x37);
	LCD_WriteData(0x00);
	LCD_WriteData(0x00);
	LCD_WriteComm(0x3A);
	LCD_WriteData(0x55);
	LCD_WriteComm(0xB1);
	LCD_WriteData(0x00);
	LCD_WriteData(0x18);
	LCD_WriteComm(0xB6);
	LCD_WriteData(0x0A);
	LCD_WriteData(0x82);
	LCD_WriteData(0x27);
	LCD_WriteData(0x00);
//	LCD_WriteComm(0xF2);
//	LCD_WriteData(0x00);
	LCD_WriteComm(0x26);
	LCD_WriteData(0x01);
	LCD_WriteComm(0xE0);
	LCD_WriteData(0x0F);
	LCD_WriteData(0x3a);
	LCD_WriteData(0x36);
	LCD_WriteData(0x0b);
	LCD_WriteData(0x0d);
	LCD_WriteData(0x06);
	LCD_WriteData(0x4c);
	LCD_WriteData(0x91);
	LCD_WriteData(0x31);
	LCD_WriteData(0x08);
	LCD_WriteData(0x10);
	LCD_WriteData(0x04);
	LCD_WriteData(0x11);
	LCD_WriteData(0x0c);
	LCD_WriteData(0x00);
	LCD_WriteComm(0XE1);
	LCD_WriteData(0x00);
	LCD_WriteData(0x06);
	LCD_WriteData(0x0a);
	LCD_WriteData(0x05);
	LCD_WriteData(0x12);
	LCD_WriteData(0x09);
	LCD_WriteData(0x2c);
	LCD_WriteData(0x92);
	LCD_WriteData(0x3f);
	LCD_WriteData(0x08);
	LCD_WriteData(0x0e);
	LCD_WriteData(0x0b);
	LCD_WriteData(0x2e);
	LCD_WriteData(0x33);
	LCD_WriteData(0x0F);
	LCD_WriteComm(0x11);
	HAL_Delay(120);
	LCD_WriteComm(0x29);
}

void LCD_setAddrWindow(unsigned short x,unsigned short y,unsigned short w,unsigned short h)
{
#if LCD_ALIGNMENT == VERTICAL
	LCD_WriteComm(0x2a);
	LCD_WriteData2(x);
	LCD_WriteData2(x+w-1);
	LCD_WriteComm(0x2b);
	LCD_WriteData2(y);
	LCD_WriteData2(y+h-1);
#elif LCD_ALIGNMENT == HORIZONTAL
	LCD_WriteComm(0x2a);
	LCD_WriteData2(y);
	LCD_WriteData2(y+h-1);
	LCD_WriteComm(0x2b);
	LCD_WriteData2(x);
	LCD_WriteData2(x+w-1);
#endif
	LCD_WriteComm(0x2c);
}

void LCD_SetCursor(unsigned short x, unsigned short y)
{
	LCD_setAddrWindow(x,y,X_RES-x,1);
}

void LCD_continuous_output(unsigned short x,unsigned short y,unsigned short color,int n)
{
	//High speed continuous output
	int i;
    unsigned short d;
	LCD_setAddrWindow(x,y,n,1);
	lcd_dc_hi();
	lcd_cs_lo();
	d=(color>>8) | (color<<8);
	for (i=0; i < n ; i++){
//		spi_write_blocking(SPICH, (unsigned char *)&d, 2);
		HAL_SPI_Transmit(&hspi1, (unsigned char *)&d, 2, 100);
	}
	lcd_cs_hi();
}
void LCD_Clear(unsigned short color)
{
	int i;
    unsigned short d;
	LCD_setAddrWindow(0,0,X_RES,Y_RES);
	lcd_dc_hi();
	lcd_cs_lo();
	d=(color>>8) | (color<<8);
	for (i=0; i < X_RES*Y_RES ; i++){
//		spi_write_blocking(SPICH, (unsigned char *)&d, 2);
		HAL_SPI_Transmit(&hspi1, (unsigned char *)&d, 2, 100);
	}
	lcd_cs_hi();
}

void drawPixel(unsigned short x, unsigned short y, unsigned short color)
{
	LCD_SetCursor(x,y);
	LCD_WriteData2(color);
}

unsigned short getColor(unsigned short x, unsigned short y)
{
	unsigned int d=0;
	LCD_SetCursor(x,y);
	LCD_Read(0x2e, (unsigned char *)&d, 3);
	return ((d&0xf8)<<8)|((d&0xfc00)>>5)|((d&0xf80000)>>19); //RGB565 format
}



unsigned short palette[256];
extern const unsigned char FontData[];

const unsigned char __attribute__((weak)) FontData[256*8]={
	0x00,0x00,0x00,0x00,0x00,0x00,0x00,0x00,
	0x00,0x00,0x00,0x00,0x00,0x00,0x00,0x00,
	0x00,0x00,0x00,0x00,0x00,0x00,0x00,0x00,
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	0x00,0x00,0x00,0x00,0x00,0x00,0x00,0x00
};


volatile unsigned short drawcount;
volatile unsigned short delaytimerflag;

void set_palette(unsigned char n,unsigned char b,unsigned char r,unsigned char g){

	palette[n]=((r>>3)<<11)+((g>>2)<<5)+(b>>3);
}

void pset(int x,int y,unsigned char c)

{
	if(x>=0 && x<X_RES && y>=0 && y<Y_RES)
		drawPixel(x,y,palette[c]);
}

void putbmpmn(int x,int y,unsigned char m,unsigned char n,const unsigned char bmp[])

{
	int i,j;
	int skip;
	const unsigned char *p;
	if(x<=-m || x>X_RES || y<=-n || y>=Y_RES) return;
	if(y<0){
		i=0;
		p=bmp-y*m;
	}
	else{
		i=y;
		p=bmp;
	}
	for(;i<y+n;i++){
		if(i>=Y_RES) return;
		if(x<0){
			j=0;
			p+=-x;
		}
		else{
			j=x;
		}
		skip=1;
		for(;j<x+m;j++){
			if(j>=X_RES){
				p+=x+m-j;
				break;
			}
			if(*p!=0){
				if(skip){
					LCD_SetCursor(j,i);
					skip=0;
				}
				LCD_WriteData2(palette[*p]);
			}
			else skip=1;
			p++;
		}
	}
}


void LCD_continuous_output(unsigned short x,unsigned short y,unsigned short color,int n);


void clrbmpmn(int x,int y,unsigned char m,unsigned char n)
{
	int i,j,k;
	if(x<=-m || x>X_RES || y<=-n || y>=Y_RES) return;
	if(y<0) i=0;
	else i=y;
	if(x<0) j=0;
	else j=x;
	if(x+m>=X_RES) k=X_RES-j;
	else k=x+m-j;
	for(;i<y+n;i++){
		if(i>=Y_RES) return;
		LCD_continuous_output(j,i,0,k);
	}
}

void gline(int x1,int y1,int x2,int y2,unsigned char c)
{
	int sx,sy,dx,dy,i;
	int e;

	if(x2>x1){
		dx=x2-x1;
		sx=1;
	}
	else{
		dx=x1-x2;
		sx=-1;
	}
	if(y2>y1){
		dy=y2-y1;
		sy=1;
	}
	else{
		dy=y1-y2;
		sy=-1;
	}
	if(dx>=dy){
		e=-dx;
		for(i=0;i<=dx;i++){
			pset(x1,y1,c);
			x1+=sx;
			e+=dy*2;
			if(e>=0){
				y1+=sy;
				e-=dx*2;
			}
		}
	}
	else{
		e=-dy;
		for(i=0;i<=dy;i++){
			pset(x1,y1,c);
			y1+=sy;
			e+=dx*2;
			if(e>=0){
				x1+=sx;
				e-=dy*2;
			}
		}
	}
}
void hline(int x1,int x2,int y,unsigned char c)
{
	int temp;

	if(y<0 || y>=Y_RES) return;
	if(x1>x2){
		temp=x1;
		x1=x2;
		x2=temp;
	}
	if(x2<0 || x1>=X_RES) return;
	if(x1<0) x1=0;
	if(x2>=X_RES) x2=X_RES-1;
	LCD_continuous_output(x1,y,palette[c],x2-x1+1);
}

void circle(int x0,int y0,unsigned int r,unsigned char c)
{
	int x,y,f;
	x=r;
	y=0;
	f=-2*r+3;
	while(x>=y){
		pset(x0-x,y0-y,c);
		pset(x0-x,y0+y,c);
		pset(x0+x,y0-y,c);
		pset(x0+x,y0+y,c);
		pset(x0-y,y0-x,c);
		pset(x0-y,y0+x,c);
		pset(x0+y,y0-x,c);
		pset(x0+y,y0+x,c);
		if(f>=0){
			x--;
			f-=x*4;
		}
		y++;
		f+=y*4+2;
	}
}
void boxfill(int x1,int y1,int x2,int y2,unsigned char c)
{
	int temp;
	if(x1>x2){
		temp=x1;
		x1=x2;
		x2=temp;
	}
	if(x2<0 || x1>=X_RES) return;
	if(y1>y2){
		temp=y1;
		y1=y2;
		y2=temp;
	}
	if(y2<0 || y1>=Y_RES) return;
	if(y1<0) y1=0;
	if(y2>=Y_RES) y2=Y_RES-1;
	while(y1<=y2){
		hline(x1,x2,y1++,c);
	}
}
void circlefill(int x0,int y0,unsigned int r,unsigned char c)
{
	int x,y,f;
	x=r;
	y=0;
	f=-2*r+3;
	while(x>=y){
		hline(x0-x,x0+x,y0-y,c);
		hline(x0-x,x0+x,y0+y,c);
		hline(x0-y,x0+y,y0-x,c);
		hline(x0-y,x0+y,y0+x,c);
		if(f>=0){
			x--;
			f-=x*4;
		}
		y++;
		f+=y*4+2;
	}
}

void putfont(int x,int y,unsigned char c,int bc,unsigned char n)

{
	int i,j;
	unsigned char d;
	int skip;
	unsigned short c1;
	const unsigned char *p;
	static unsigned char lcddatabuf[16];
	unsigned char *lcdbufp;
	if(x<=-8 || x>=X_RES || y<=-8 || y>=Y_RES) return;
	if(y<0){
		i=0;
		p=FontData+n*8-y;
	}
	else{
		i=y;
		p=FontData+n*8;
	}
	c1=palette[c];
	if(bc>=0) bc=palette[bc];
	for(;i<y+8;i++){
		if(i>=Y_RES) return;
		d=*p++;
		if(x<0){
			j=0;
			d<<=-x;
		}
		else{
			j=x;
		}
		if(bc<0){
			skip=1;
			for(;j<x+8;j++){
				if(j>=X_RES){
					break;
				}
				if(d&0x80){
					if(skip){
						LCD_SetCursor(j,i);
						skip=0;
					}
					LCD_WriteData2(c1);
				}
				else skip=1;
				d<<=1;
			}
		}
		else{
			LCD_SetCursor(j,i);
			lcdbufp=lcddatabuf;
			for(;j<x+8;j++){
				if(j>=X_RES){
					break;
				}
				if(d&0x80){
					*lcdbufp++=c1>>8;
					*lcdbufp++=(unsigned char)c1;
				}
				else{
					*lcdbufp++=bc>>8;
					*lcdbufp++=(unsigned char)bc;
				}
				d<<=1;
			}
			if(lcdbufp!=lcddatabuf) LCD_WriteDataN(lcddatabuf,lcdbufp-lcddatabuf);
		}
	}
}

void printstr(int x,int y,unsigned char c,int bc,unsigned char *s){
	while(*s){
		putfont(x,y,c,bc,*s++);
		x+=8;
	}
}
void printnum(int x,int y,unsigned char c,int bc,unsigned int n){
	unsigned int d,e;
	d=10;
	e=0;
	while(n>=d){
		e++;
		if(e==9) break;
		d*=10;
	}
	x+=e*8;
	do{
		putfont(x,y,c,bc,'0'+n%10);
		n/=10;
		x-=8;
	}while(n!=0);
}
void printnum2(int x,int y,unsigned char c,int bc,unsigned int n,unsigned char e){
	if(e==0) return;
	x+=(e-1)*8;
	do{
		putfont(x,y,c,bc,'0'+n%10);
		e--;
		n/=10;
		x-=8;
	}while(e!=0 && n!=0);
	while(e!=0){
		putfont(x,y,c,bc,' ');
		x-=8;
		e--;
	}
}

void init_graphic(void){
	int i;
	for(i=0;i<8;i++){
		set_palette(i,255*(i&1),255*((i>>1)&1),255*(i>>2));
	}
	for(i=0;i<8;i++){
		set_palette(i+8,128*(i&1),128*((i>>1)&1),128*(i>>2));
	}
	for(i=16;i<256;i++){
		set_palette(i,255,255,255);
	}

	LCD_Init();
	LCD_Clear(0);
}


void DelayUs(volatile uint32_t us)
{
		us *= (SystemCoreClock / 1000000);
		while (us--);
}
